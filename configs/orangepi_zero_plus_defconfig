## configs/orangepi_zero_plus_defconfig
```kconfig
CONFIG_ARM=y
CONFIG_ARCH_SUNXI=y
CONFIG_SPL=y
CONFIG_MACH_SUN50I_H5=y
CONFIG_DRAM_CLK=624
CONFIG_DRAM_ZQ=3881977
# CONFIG_DRAM_ODT_EN is not set
# CONFIG_SYS_MALLOC_CLEAR_ON_INIT is not set
CONFIG_DEFAULT_DEVICE_TREE="sun50i-h5-orangepi-zero-plus"
CONFIG_SUN8I_EMAC=y
CONFIG_USB_EHCI_HCD=y
CONFIG_USB_OHCI_HCD=y
CONFIG_VIDEO=y
CONFIG_VIDEO_SUNXI=y
CONFIG_ST7789V=y
# CONFIG_VIDEO_LCD_MODE="x:240,y:320,depth:24,pclk_khz:40000,hs:1,vs:1,le:46,ri:210,up:23,lo:22,sync:0,vmode:0"
# CONFIG_VIDEO_LCD_ROTATION=1
# CONFIG_VIDEO_LCD_DCLK_PHASE=1
# CONFIG_VIDEO_LCD_POWER="PA7"
# CONFIG_VIDEO_LCD_RESET="PA2"
# CONFIG_VIDEO_LCD_BL_EN=""
# CONFIG_VIDEO_LCD_BL_PWM="PA6"
# CONFIG_VIDEO_LCD_BL_PWM_ACTIVE_LOW=y
# CONFIG_VIDEO_LCD_IF_PARALLEL=y
# CONFIG_VIDEO_LCD_PANEL_PARALLEL=y
# CONFIG_VIDEO_LCD_SSD2828=y
# CONFIG_VIDEO_LCD_SSD2828_TX_CLK=27
# CONFIG_VIDEO_LCD_PANEL_MIPI_4_LANE_513_MBPS_VIA_SSD2828=y
# CONFIG_VIDEO_LCD_SSD2828_RESET="PA02"
# CONFIG_VIDEO_LCD_SPI_CS="PA13"
# CONFIG_VIDEO_LCD_SPI_SCLK="PA14"
# CONFIG_VIDEO_LCD_SPI_MOSI="PA15"
# CONFIG_VIDEO_LCD_SPI_MISO="PA16"
```
